## boards/sks_airspy/Kconfig.defconfig
```kconfig
# Copyright (c) 2026 Arne Wendt (@bitmeal)
# SPDX-License-Identifier: MPL-2.0

if BOARD_SKS_AIRSPY

config HW_STACK_PROTECTION
	default ARCH_HAS_STACK_PROTECTION

endif # BOARD_SKS_AIRSPY
```

## boards/sks_airspy/Kconfig.sks_airspy
```kconfig
# Copyright (c) 2024 Arne Wendt (@bitmeal)
# SPDX-License-Identifier: Apache-2.0

config BOARD_SKS_AIRSPY
	select SOC_NRF52832_QFAA
	# select HAS_BT_CTLR if BT
	# select SOC_DCDC_NRF52X
```

## boards/sks_airspy/sks_airspy_defconfig
```kconfig
# Copyright (c) 2025 Arne Wendt (@bitmeal)
# SPDX-License-Identifier: MPL-2.0

# Enable MPU
CONFIG_ARM_MPU=y

# Pinctrl
CONFIG_PINCTRL=y
```
