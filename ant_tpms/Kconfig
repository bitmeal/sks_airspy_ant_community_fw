## ant_tpms/Kconfig
```kconfig
#
# Copyright 2022 by Garmin Ltd. or its subsidiaries.
# All rights reserved.
#
# Use of this Software is limited and subject to the License Agreement for ANT SoftDevice
# and Associated Software. The Agreement accompanies the Software in the root directory of
# the repository.
#

menuconfig ANT_TPMS
    bool "ANT+ TPMS profile"
    # select ANT_COMMON
    # select ANT_PROFILES
    depends on ANT
    # select ANT
    help
      Support for ANT+ TPMS constants and pages

if ANT_TPMS

config ANT_TPMS_SIMULATOR
    bool "Enable ANT+ TPMS Simulator"
    select SENSORSIM

rsource "lib/pages/Kconfig"

if ANT_TPMS_SIMULATOR
rsource "lib/simulator/Kconfig"
endif # ANT_TPMS_SIMULATOR

module=ANT_TPMS
module-str=ANT+ TPMS
source "${ZEPHYR_BASE}/subsys/logging/Kconfig.template.log_config"

endif # ANT_TPMS
```

## ant_tpms/lib/pages/Kconfig
```kconfig
#
# Copyright 2022 by Garmin Ltd. or its subsidiaries.
# All rights reserved.
#
# Use of this Software is limited and subject to the License Agreement for ANT SoftDevice
# and Associated Software. The Agreement accompanies the Software in the root directory of
# the repository.
#

module = TPMS_PAGES
module-str = ANT+ TPMS Pages
source "${ZEPHYR_BASE}/subsys/logging/Kconfig.template.log_config"
```

## ant_tpms/lib/simulator/Kconfig
```kconfig
#
# Copyright 2022 by Garmin Ltd. or its subsidiaries.
# All rights reserved.
#
# Use of this Software is limited and subject to the License Agreement for ANT SoftDevice
# and Associated Software. The Agreement accompanies the Software in the root directory of
# the repository.
#

module = TPMS_SIMULATOR
module-str = ANT+ TPMS Simulator
source "${ZEPHYR_BASE}/subsys/logging/Kconfig.template.log_config"
```

## boards/sks_airspy/board.yml
```yaml
# Copyright (c) 2025 Arne Wendt (@bitmeal)
# SPDX-License-Identifier: MPL-2.0

board:
  name: sks_airspy
  vendor: sks
  socs:
  - name: nrf52832
```

## boards/sks_devel/sks_devel_nrf52840_mdk/Kconfig
```kconfig
# SKS Devel nRF52840 MDK board configuration

# Copyright (c) 2022 Nikola Trifunovic
# Copyright (c) 2018 Nordic Semiconductor ASA
# SPDX-License-Identifier: Apache-2.0

if BOARD_SKS_DEVEL_NRF52840_MDK

config BOARD_ENABLE_DCDC
	bool "DCDC mode"
	select SOC_DCDC_NRF52X
	default y

# config BOARD_HAS_NRF5_BOOTLOADER
# 	bool "Board has nRF5 bootloader"
# 	default n
# 	help
# 	  If selected, applications are linked so that they can be loaded by Nordic
# 	  nRF5 bootloader.

endif # BOARD_SKS_DEVEL_NRF52840_MDK
```

## boards/sks_devel/sks_devel_nrf52840_mdk/Kconfig.sks_devel_nrf52840_mdk
```kconfig
# SKS Devel nRF52840 MDK board configuration

# Copyright (c) 2022 Nikola Trifunovic
# Copyright (c) 2018 Nordic Semiconductor ASA
# SPDX-License-Identifier: Apache-2.0

config BOARD_SKS_DEVEL_NRF52840_MDK
	select SOC_NRF52840_QIAA
```

## boards/sks_devel/sks_devel_nrf52840_mdk/board.yml
```yaml
board:
  name: sks_devel_nrf52840_mdk
  vendor: sks_devel
  socs:
  - name: nrf52840
```

## boards/sks_devel/sks_devel_nrf52840_mdk/sks_devel_nrf52840_mdk_defconfig
```kconfig
# SPDX-License-Identifier: Apache-2.0

# Bootloader
CONFIG_BOOTLOADER_MCUBOOT=y

# Enable MPU
CONFIG_ARM_MPU=y

# Console
CONFIG_CONSOLE=y
CONFIG_SERIAL=y
CONFIG_UART_CONSOLE=y

# Enable hardware stack protection
CONFIG_HW_STACK_PROTECTION=y

# enable GPIO
CONFIG_GPIO=y

# enable RTT
CONFIG_USE_SEGGER_RTT=y
CONFIG_UART_RTT=y
```

## boards/sks_devel/sks_devel_ruuvitag/Kconfig.defconfig
```kconfig
# Ruuvi RuuviTag configuration

# Copyright (c) 2020 Ruuvi Innovations Ltd (Oy)
# SPDX-License-Identifier: Apache-2.0

if BOARD_SKS_DEVEL_RUUVITAG

config SPI
	default n

config BT_CTLR
	default BT

endif # BOARD_SKS_DEVEL_RUUVITAG
```

## boards/sks_devel/sks_devel_ruuvitag/Kconfig.sks_devel_ruuvitag
```kconfig
# Copyright (c) 2020 Ruuvi Innovations Ltd (Oy)
# SPDX-License-Identifier: Apache-2.0

config BOARD_SKS_DEVEL_RUUVITAG
	select SOC_NRF52832_QFAA
```

## boards/sks_devel/sks_devel_ruuvitag/board.yml
```yaml
board:
  name: sks_devel_ruuvitag
  vendor: sks_devel
  socs:
  - name: nrf52832
```

## boards/sks_devel/sks_devel_ruuvitag/sks_devel_ruuvitag_defconfig
```kconfig
# Copyright (c) 2020 Ruuvi Innovations Ltd (Oy)
# SPDX-License-Identifier: Apache-2.0

# Bootloader
CONFIG_BOOTLOADER_MCUBOOT=y

# Enable MPU
CONFIG_ARM_MPU=y

# Enable console
CONFIG_CONSOLE=y
CONFIG_UART_CONSOLE=y
CONFIG_SERIAL=y

# Enable RTT
CONFIG_USE_SEGGER_RTT=y
CONFIG_UART_RTT=y

# Enable GPIO
CONFIG_GPIO=y

CONFIG_PINCTRL=y
```

## boards/sks_devel/sks_devel_sks_airspy/Kconfig.sks_devel_sks_airspy
```kconfig
# Copyright (c) 2024 Arne Wendt (@bitmeal)
# SPDX-License-Identifier: Apache-2.0

config BOARD_SKS_DEVEL_SKS_AIRSPY
	select SOC_NRF52832_QFAA
	select SOC_DCDC_NRF52X
	# select BT_CTLR
	# select SPI
	# select GPIO
```

## boards/sks_devel/sks_devel_sks_airspy/board.yml
```yaml
board:
  name: sks_devel_sks_airspy
  vendor: sks_devel
  socs:
  - name: nrf52832
```

## boards/sks_devel/sks_devel_sks_airspy/sks_devel_sks_airspy_defconfig
```kconfig
# Copyright (c) 2024 Arne Wendt (@bitmeal)
# SPDX-License-Identifier: Apache-2.0

# Bootloader
CONFIG_BOOTLOADER_MCUBOOT=y
# # 512kB flash; two images (each < 256kB); sector size 0x1000 / 4096B
# CONFIG_BOOT_MAX_IMG_SECTORS=64


# Enable MPU
CONFIG_ARM_MPU=y

# Enable console
CONFIG_CONSOLE=y
CONFIG_SERIAL=y

# Enable RTT
CONFIG_USE_SEGGER_RTT=y
CONFIG_UART_RTT=y

# Enable GPIO
CONFIG_GPIO=y

# Enable SPI
CONFIG_SPI=y

# Pinctrl
CONFIG_PINCTRL=y
```

## boards/sks_devel_nrf52840_mdk/Kconfig.defconfig
```kconfig
# Copyright (c) 2025 Arne Wendt (@bitmeal)
# SPDX-License-Identifier: MPL-2.0

# SKS Devel nRF52840 MDK board configuration

if BOARD_SKS_DEVEL_NRF52840_MDK

if USB_DEVICE_STACK

# Enable UART driver, needed for CDC ACM
config SERIAL
	default y

endif # USB_DEVICE_STACK

config BT_CTLR
	default BT

endif # BOARD_SKS_DEVEL_NRF52840_MDK
```

## boards/sks_devel_nrf52840_mdk/Kconfig.sks_devel_nrf52840_mdk
```kconfig
# Copyright (c) 2024 Arne Wendt (@bitmeal)
# SPDX-License-Identifier: Apache-2.0

config BOARD_SKS_DEVEL_NRF52840_MDK
	select SOC_NRF52840_QIAA
	select SOC_DCDC_NRF52X
```

## boards/sks_devel_nrf52840_mdk/board.yml
```yaml
# Copyright (c) 2025 Arne Wendt (@bitmeal)
# SPDX-License-Identifier: MPL-2.0

board:
  name: sks_devel_nrf52840_mdk
  vendor: sks_devel
  socs:
  - name: nrf52840
```
